## package/batocera/controllers/snesdev/Config.in
```kconfig
config BR2_PACKAGE_SNESDEV
        bool "snesdev"
        depends on BR2_PACKAGE_LIBCONFUSE

comment "SNESDev is a user-space driver for the RetroPie GPIO Adapter"
```
